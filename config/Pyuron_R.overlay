#include <dt-bindings/zmk/input_transform.h>
#include <input/processors.dtsi>

&zip_temp_layer {
    require-prior-idle-ms = <200>;
};

&trackball_listener_R {
    input-processors =
        <&zip_xy_transform (INPUT_TRANSFORM_XY_SWAP | INPUT_TRANSFORM_Y_INVERT)>,
        <&zip_temp_layer 6 1000>;
};
